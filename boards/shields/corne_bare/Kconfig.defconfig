## boards/shields/corne_bare/Kconfig.defconfig
```kconfig
if SHIELD_CORNE_BARE_LEFT || SHIELD_CORNE_BARE_RIGHT

config ZMK_SPLIT
    default y

config ZMK_SPLIT_BLE
    default y

config ZMK_BLE
    default y

endif
```

## boards/shields/corne_bare/Kconfig.shield
```kconfig
config SHIELD_CORNE_BARE_LEFT
    def_bool $(shields_list_contains,corne_bare_left)

config SHIELD_CORNE_BARE_RIGHT
    def_bool $(shields_list_contains,corne_bare_right)
```

## boards/shields/corne_dongle/Kconfig.shield
```kconfig
config SHIELD_CORNE_DONGLE
    def_bool $(shields_list_contains,corne_dongle)

config SHIELD_CORNE_PERIPHERAL_LEFT
    def_bool $(shields_list_contains,corne_peripheral_left)

config SHIELD_CORNE_PERIPHERAL_RIGHT
    def_bool $(shields_list_contains,corne_peripheral_right)
```
